/*
Initial Pulse Width Modulation (PWM) code for one motor using a potentiomenter.
PWMvalue1 corresponds to straight brine solution (24% salt diluted in H2O)
PWMvalue2 corresponds to CaCl2
*/

const int PWMpin1 = 9; //Pin 9 is for the first motor - Brine 
const int PWMpin2 = 6; // Pin 6 is for the second motor - CaCl
const int POTpin = 0; //Potentiometer connected to A0
const int RLED = 12; //Red LED light digital pin 9 - Indicates 100% Brine 
const int GLED = 10; //Green LED light digital pin 8 - Indicates 70% brine 30% CaCl
const int BLED = 7; //Blue LED light digital pin 7 - Indicated 60% brine 40% CaCl

void setup() {
  //Sets the PWM pins as outputs
    pinMode(PWMpin1, OUTPUT);
    pinMode(PWMpin2, OUTPUT);
    
  //Set the LED pins as outputs
    pinMode(RLED, OUTPUT);
    pinMode(GLED, OUTPUT);
    pinMode(BLED, OUTPUT);
    
  //Sets potentiometer pin as an input
    pinMode(POTpin, INPUT);
    Serial.begin(9600);
}

void loop() {
  //Read potentiometer value 0-1023
  int POTvalue = analogRead(POTpin);
  
  //Map the pot value to a range between 0 and 255 for PWM
  int PWMvalue1 = map(POTvalue, 0, 1023, 0, 255);
  int PWMvalue2 = map(POTvalue, 0, 1023, 0, 255);
    
  //Prevents motor squeal for low percentage duty cycles
  if (PWMvalue1 <= 50 || PWMvalue2 <= 50) { 
    PWMvalue1 = 0;
    PWMvalue2 = 0;
    digitalWrite(RLED, LOW); //Turns off red indicator light
  }else {
    //Creates "temperature" ranges and sets the duty cycle(motor speed) for the given conditions
    //Also sets the LED indicator on/off to show the mixture in use 
    if (POTvalue >= 0 && POTvalue <= 600) { //Engages at about a POTvalue of 205 b/c of the above if statement
    PWMvalue1 = 255; //100% duty cycle for motor one- 100% Brine
    PWMvalue2 = 0;
    digitalWrite(BLED, LOW); //Turns off blue indicator light
    digitalWrite(GLED, LOW); //Turns off green indicator light
    digitalWrite(RLED, HIGH); //Turns on red indicator light
  }else if (POTvalue > 600 && POTvalue <= 770) {
    PWMvalue1 = 178.5; //(255)*(0.7) = 178.5 which is about 70% motor speed- 70% Brine
    PWMvalue2 =  90; //(255)*(0.3) = 76.5 which is about 30% motor speed- 30% CaCl
    digitalWrite(RLED, LOW); //Turns off red indicator light
    digitalWrite(BLED, LOW); //Turns off blue indicator light
    digitalWrite(GLED, HIGH); //Turns on green indicator light
  }else if (POTvalue > 770) {
    PWMvalue1 = 153; //(255)*(0.6) = 153 which is abobut 60% motor speed- 60% Brine
    PWMvalue2 = 102; //(255)*(0.4) = 102 which is about 40% motor speed- 40% CaCl
    digitalWrite(GLED, LOW); //Turns off green indicator light
    digitalWrite(RLED, LOW); //Turns off red indicator light
    digitalWrite(BLED, HIGH); //Turns on blue indicator light
  }
}
  
  //Note that these are simply percentage ranges for the motor, and that the direct correlation
  //between motor speed and % composition of mixture still needs to be tested.
  
  //Use that value to control transistor and hence the motor speed
  analogWrite(PWMpin1, PWMvalue1);
  analogWrite(PWMpin2, PWMvalue2);
  
  //Print the potentiometer/PWM value for reference
  //Serial.println(PWMvalue1);
  //Serial.println(PWMvalue2);
  Serial.println(POTvalue);
}